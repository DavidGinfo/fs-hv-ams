VERSION ""

NS_ :

BS_:

BU_: AMS

BO_ 0 AMS_Shield: 2 AMS
 SG_ Temperature_Cell1 : 0|10@1+ (0.1,0) [0|102.3] "°C" Vector__XXX

BA_DEF_ BO_  "GenMsgSendType2" ENUM  "Zyklisch","Ereignisgesteuert","dummy","Auf Anfrage";
BA_DEF_ BO_  "GenMsgCycleTimeActive" INT 1 100;
BA_DEF_ BO_  "GenMsgCycleTimeFast" INT 1 50;
BA_DEF_ BO_  "GenMsgFastOnStart" INT 10 500;
BA_DEF_ BO_  "GenMsgDelayTime" INT 10 500;
BA_DEF_ BO_  "GenSigSendType" ENUM  "Cyclic","OnWrite","OnChange";
BA_DEF_ BO_  "GenMsgSendType" ENUM  "cyclic","spontaneous","adaptive";
BA_DEF_ BO_  "GenMsgCycleTime" INT 5 1000;
BA_DEF_ BU_  "MessageManagerUsed" ENUM  "no","yes";
BA_DEF_  "Manufacturer" ENUM  "DBAG","VAG","BMWAG";
BA_DEF_  "BusType" STRING ;
BA_DEF_DEF_  "GenMsgSendType2" "Zyklisch";
BA_DEF_DEF_  "GenMsgCycleTimeActive" 10;
BA_DEF_DEF_  "GenMsgCycleTimeFast" 10;
BA_DEF_DEF_  "GenMsgFastOnStart" 10;
BA_DEF_DEF_  "GenMsgDelayTime" 10;
BA_DEF_DEF_  "GenSigSendType" "Cyclic";
BA_DEF_DEF_  "GenMsgSendType" "cyclic";
BA_DEF_DEF_  "GenMsgCycleTime" 100;
BA_DEF_DEF_  "MessageManagerUsed" "yes";
BA_DEF_DEF_  "Manufacturer" "BMWAG";
BA_DEF_DEF_  "BusType" "CAN";
